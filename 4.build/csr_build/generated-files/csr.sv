// SPDX-FileCopyrightText: 2026 Chili.CHIPS*ba
//
// SPDX-License-Identifier: BSD-3-Clause

// Generated by PeakRDL-regblock - A free and open-source SystemVerilog generator
//  https://github.com/SystemRDL/PeakRDL-regblock

module csr (
        input wire clk,
        input wire rst,

        input wire s_cpuif_req,
        input wire s_cpuif_req_is_wr,
        input wire [5:0] s_cpuif_addr,
        input wire [31:0] s_cpuif_wr_data,
        input wire [31:0] s_cpuif_wr_biten,
        output wire s_cpuif_req_stall_wr,
        output wire s_cpuif_req_stall_rd,
        output wire s_cpuif_rd_ack,
        output wire s_cpuif_rd_err,
        output wire [31:0] s_cpuif_rd_data,
        output wire s_cpuif_wr_ack,
        output wire s_cpuif_wr_err,

        input csr_pkg::csr__in_t hwif_in,
        output csr_pkg::csr__out_t hwif_out
    );

    //--------------------------------------------------------------------------
    // CPU Bus interface logic
    //--------------------------------------------------------------------------
    logic cpuif_req;
    logic cpuif_req_is_wr;
    logic [5:0] cpuif_addr;
    logic [31:0] cpuif_wr_data;
    logic [31:0] cpuif_wr_biten;
    logic cpuif_req_stall_wr;
    logic cpuif_req_stall_rd;

    logic cpuif_rd_ack;
    logic cpuif_rd_err;
    logic [31:0] cpuif_rd_data;

    logic cpuif_wr_ack;
    logic cpuif_wr_err;

    assign cpuif_req = s_cpuif_req;
    assign cpuif_req_is_wr = s_cpuif_req_is_wr;
    assign cpuif_addr = s_cpuif_addr;
    assign cpuif_wr_data = s_cpuif_wr_data;
    assign cpuif_wr_biten = s_cpuif_wr_biten;
    assign s_cpuif_req_stall_wr = cpuif_req_stall_wr;
    assign s_cpuif_req_stall_rd = cpuif_req_stall_rd;
    assign s_cpuif_rd_ack = cpuif_rd_ack;
    assign s_cpuif_rd_err = cpuif_rd_err;
    assign s_cpuif_rd_data = cpuif_rd_data;
    assign s_cpuif_wr_ack = cpuif_wr_ack;
    assign s_cpuif_wr_err = cpuif_wr_err;

    logic cpuif_req_masked;

    // Read & write latencies are balanced. Stalls not required
    assign cpuif_req_stall_rd = '0;
    assign cpuif_req_stall_wr = '0;
    assign cpuif_req_masked = cpuif_req
                            & !(!cpuif_req_is_wr & cpuif_req_stall_rd)
                            & !(cpuif_req_is_wr & cpuif_req_stall_wr);

    //--------------------------------------------------------------------------
    // Address Decode
    //--------------------------------------------------------------------------
    typedef struct {
        struct {
            logic header0;
            logic header1;
            logic header2;
            logic data;
        } tx;
        struct {
            logic status;
            logic data;
            logic header_info;
        } rx;
        struct {
            logic err;
            logic phy;
        } status;
    } decoded_reg_strb_t;
    decoded_reg_strb_t decoded_reg_strb;
    logic decoded_err;
    logic [5:0] decoded_addr;
    logic decoded_req;
    logic decoded_req_is_wr;
    logic [31:0] decoded_wr_data;
    logic [31:0] decoded_wr_biten;

    always_comb begin
        automatic logic is_valid_addr;
        automatic logic is_valid_rw;
        is_valid_addr = '1; // No valid address check
        is_valid_rw = '1; // No valid RW check
        decoded_reg_strb.tx.header0 = cpuif_req_masked & (cpuif_addr == 6'h0);
        decoded_reg_strb.tx.header1 = cpuif_req_masked & (cpuif_addr == 6'h4);
        decoded_reg_strb.tx.header2 = cpuif_req_masked & (cpuif_addr == 6'h8);
        decoded_reg_strb.tx.data = cpuif_req_masked & (cpuif_addr == 6'hc);
        decoded_reg_strb.rx.status = cpuif_req_masked & (cpuif_addr == 6'h10) & !cpuif_req_is_wr;
        decoded_reg_strb.rx.data = cpuif_req_masked & (cpuif_addr == 6'h14) & !cpuif_req_is_wr;
        decoded_reg_strb.rx.header_info = cpuif_req_masked & (cpuif_addr == 6'h18) & !cpuif_req_is_wr;
        decoded_reg_strb.status.err = cpuif_req_masked & (cpuif_addr == 6'h1c) & !cpuif_req_is_wr;
        decoded_reg_strb.status.phy = cpuif_req_masked & (cpuif_addr == 6'h20) & !cpuif_req_is_wr;
        decoded_err = '0;
    end

    // Pass down signals to next stage
    assign decoded_addr = cpuif_addr;
    assign decoded_req = cpuif_req_masked;
    assign decoded_req_is_wr = cpuif_req_is_wr;
    assign decoded_wr_data = cpuif_wr_data;
    assign decoded_wr_biten = cpuif_wr_biten;

    //--------------------------------------------------------------------------
    // Field logic
    //--------------------------------------------------------------------------
    typedef struct {
        struct {
            struct {
                struct {
                    logic [31:0] next;
                    logic load_next;
                } hdr;
            } header0;
            struct {
                struct {
                    logic [31:0] next;
                    logic load_next;
                } hdr;
            } header1;
            struct {
                struct {
                    logic [31:0] next;
                    logic load_next;
                } hdr;
            } header2;
            struct {
                struct {
                    logic [31:0] next;
                    logic load_next;
                } payload;
            } data;
        } tx;
        struct {
            struct {
                struct {
                    logic [2:0] next;
                    logic load_next;
                } cpl_status;
            } status;
            struct {
                struct {
                    logic [31:0] next;
                    logic load_next;
                } payload;
            } data;
            struct {
                struct {
                    logic [6:0] next;
                    logic load_next;
                } lower_addr;
                struct {
                    logic [7:0] next;
                    logic load_next;
                } tag;
                struct {
                    logic [15:0] next;
                    logic load_next;
                } requester_id;
            } header_info;
        } rx;
    } field_combo_t;
    field_combo_t field_combo;

    typedef struct {
        struct {
            struct {
                struct {
                    logic [31:0] value;
                } hdr;
            } header0;
            struct {
                struct {
                    logic [31:0] value;
                } hdr;
            } header1;
            struct {
                struct {
                    logic [31:0] value;
                } hdr;
            } header2;
            struct {
                struct {
                    logic [31:0] value;
                } payload;
            } data;
        } tx;
        struct {
            struct {
                struct {
                    logic [2:0] value;
                } cpl_status;
            } status;
            struct {
                struct {
                    logic [31:0] value;
                } payload;
            } data;
            struct {
                struct {
                    logic [6:0] value;
                } lower_addr;
                struct {
                    logic [7:0] value;
                } tag;
                struct {
                    logic [15:0] value;
                } requester_id;
            } header_info;
        } rx;
    } field_storage_t;
    field_storage_t field_storage;

    // Field: csr.tx.header0.hdr
    always_comb begin
        automatic logic [31:0] next_c;
        automatic logic load_next_c;
        next_c = field_storage.tx.header0.hdr.value;
        load_next_c = '0;
        if(decoded_reg_strb.tx.header0 && decoded_req_is_wr) begin // SW write
            next_c = (field_storage.tx.header0.hdr.value & ~decoded_wr_biten[31:0]) | (decoded_wr_data[31:0] & decoded_wr_biten[31:0]);
            load_next_c = '1;
        end
        field_combo.tx.header0.hdr.next = next_c;
        field_combo.tx.header0.hdr.load_next = load_next_c;
    end
    always_ff @(posedge clk) begin
        if(rst) begin
            field_storage.tx.header0.hdr.value <= 32'h0;
        end else begin
            if(field_combo.tx.header0.hdr.load_next) begin
                field_storage.tx.header0.hdr.value <= field_combo.tx.header0.hdr.next;
            end
        end
    end
    assign hwif_out.tx.header0.hdr.value = field_storage.tx.header0.hdr.value;
    // Field: csr.tx.header1.hdr
    always_comb begin
        automatic logic [31:0] next_c;
        automatic logic load_next_c;
        next_c = field_storage.tx.header1.hdr.value;
        load_next_c = '0;
        if(decoded_reg_strb.tx.header1 && decoded_req_is_wr) begin // SW write
            next_c = (field_storage.tx.header1.hdr.value & ~decoded_wr_biten[31:0]) | (decoded_wr_data[31:0] & decoded_wr_biten[31:0]);
            load_next_c = '1;
        end
        field_combo.tx.header1.hdr.next = next_c;
        field_combo.tx.header1.hdr.load_next = load_next_c;
    end
    always_ff @(posedge clk) begin
        if(rst) begin
            field_storage.tx.header1.hdr.value <= 32'h0;
        end else begin
            if(field_combo.tx.header1.hdr.load_next) begin
                field_storage.tx.header1.hdr.value <= field_combo.tx.header1.hdr.next;
            end
        end
    end
    assign hwif_out.tx.header1.hdr.value = field_storage.tx.header1.hdr.value;
    // Field: csr.tx.header2.hdr
    always_comb begin
        automatic logic [31:0] next_c;
        automatic logic load_next_c;
        next_c = field_storage.tx.header2.hdr.value;
        load_next_c = '0;
        if(decoded_reg_strb.tx.header2 && decoded_req_is_wr) begin // SW write
            next_c = (field_storage.tx.header2.hdr.value & ~decoded_wr_biten[31:0]) | (decoded_wr_data[31:0] & decoded_wr_biten[31:0]);
            load_next_c = '1;
        end
        field_combo.tx.header2.hdr.next = next_c;
        field_combo.tx.header2.hdr.load_next = load_next_c;
    end
    always_ff @(posedge clk) begin
        if(rst) begin
            field_storage.tx.header2.hdr.value <= 32'h0;
        end else begin
            if(field_combo.tx.header2.hdr.load_next) begin
                field_storage.tx.header2.hdr.value <= field_combo.tx.header2.hdr.next;
            end
        end
    end
    assign hwif_out.tx.header2.hdr.value = field_storage.tx.header2.hdr.value;
    // Field: csr.tx.data.payload
    always_comb begin
        automatic logic [31:0] next_c;
        automatic logic load_next_c;
        next_c = field_storage.tx.data.payload.value;
        load_next_c = '0;
        if(decoded_reg_strb.tx.data && decoded_req_is_wr) begin // SW write
            next_c = (field_storage.tx.data.payload.value & ~decoded_wr_biten[31:0]) | (decoded_wr_data[31:0] & decoded_wr_biten[31:0]);
            load_next_c = '1;
        end
        field_combo.tx.data.payload.next = next_c;
        field_combo.tx.data.payload.load_next = load_next_c;
    end
    always_ff @(posedge clk) begin
        if(rst) begin
            field_storage.tx.data.payload.value <= 32'h0;
        end else begin
            if(field_combo.tx.data.payload.load_next) begin
                field_storage.tx.data.payload.value <= field_combo.tx.data.payload.next;
            end
        end
    end
    assign hwif_out.tx.data.payload.value = field_storage.tx.data.payload.value;
    assign hwif_out.tx.data.payload.swmod = decoded_reg_strb.tx.data && decoded_req_is_wr && |(decoded_wr_biten[31:0]);
    // Field: csr.rx.status.cpl_status
    always_comb begin
        automatic logic [2:0] next_c;
        automatic logic load_next_c;
        next_c = field_storage.rx.status.cpl_status.value;
        load_next_c = '0;
        if(hwif_in.rx.status.cpl_status.we) begin // HW Write - we
            next_c = hwif_in.rx.status.cpl_status.next;
            load_next_c = '1;
        end
        field_combo.rx.status.cpl_status.next = next_c;
        field_combo.rx.status.cpl_status.load_next = load_next_c;
    end
    always_ff @(posedge clk) begin
        if(rst) begin
            field_storage.rx.status.cpl_status.value <= 3'h0;
        end else begin
            if(field_combo.rx.status.cpl_status.load_next) begin
                field_storage.rx.status.cpl_status.value <= field_combo.rx.status.cpl_status.next;
            end
        end
    end
    // Field: csr.rx.data.payload
    always_comb begin
        automatic logic [31:0] next_c;
        automatic logic load_next_c;
        next_c = field_storage.rx.data.payload.value;
        load_next_c = '0;
        if(hwif_in.rx.data.payload.we) begin // HW Write - we
            next_c = hwif_in.rx.data.payload.next;
            load_next_c = '1;
        end
        field_combo.rx.data.payload.next = next_c;
        field_combo.rx.data.payload.load_next = load_next_c;
    end
    always_ff @(posedge clk) begin
        if(rst) begin
            field_storage.rx.data.payload.value <= 32'h0;
        end else begin
            if(field_combo.rx.data.payload.load_next) begin
                field_storage.rx.data.payload.value <= field_combo.rx.data.payload.next;
            end
        end
    end
    // Field: csr.rx.header_info.lower_addr
    always_comb begin
        automatic logic [6:0] next_c;
        automatic logic load_next_c;
        next_c = field_storage.rx.header_info.lower_addr.value;
        load_next_c = '0;
        if(hwif_in.rx.header_info.lower_addr.we) begin // HW Write - we
            next_c = hwif_in.rx.header_info.lower_addr.next;
            load_next_c = '1;
        end
        field_combo.rx.header_info.lower_addr.next = next_c;
        field_combo.rx.header_info.lower_addr.load_next = load_next_c;
    end
    always_ff @(posedge clk) begin
        if(rst) begin
            field_storage.rx.header_info.lower_addr.value <= 7'h0;
        end else begin
            if(field_combo.rx.header_info.lower_addr.load_next) begin
                field_storage.rx.header_info.lower_addr.value <= field_combo.rx.header_info.lower_addr.next;
            end
        end
    end
    // Field: csr.rx.header_info.tag
    always_comb begin
        automatic logic [7:0] next_c;
        automatic logic load_next_c;
        next_c = field_storage.rx.header_info.tag.value;
        load_next_c = '0;
        if(hwif_in.rx.header_info.tag.we) begin // HW Write - we
            next_c = hwif_in.rx.header_info.tag.next;
            load_next_c = '1;
        end
        field_combo.rx.header_info.tag.next = next_c;
        field_combo.rx.header_info.tag.load_next = load_next_c;
    end
    always_ff @(posedge clk) begin
        if(rst) begin
            field_storage.rx.header_info.tag.value <= 8'h0;
        end else begin
            if(field_combo.rx.header_info.tag.load_next) begin
                field_storage.rx.header_info.tag.value <= field_combo.rx.header_info.tag.next;
            end
        end
    end
    // Field: csr.rx.header_info.requester_id
    always_comb begin
        automatic logic [15:0] next_c;
        automatic logic load_next_c;
        next_c = field_storage.rx.header_info.requester_id.value;
        load_next_c = '0;
        if(hwif_in.rx.header_info.requester_id.we) begin // HW Write - we
            next_c = hwif_in.rx.header_info.requester_id.next;
            load_next_c = '1;
        end
        field_combo.rx.header_info.requester_id.next = next_c;
        field_combo.rx.header_info.requester_id.load_next = load_next_c;
    end
    always_ff @(posedge clk) begin
        if(rst) begin
            field_storage.rx.header_info.requester_id.value <= 16'h0;
        end else begin
            if(field_combo.rx.header_info.requester_id.load_next) begin
                field_storage.rx.header_info.requester_id.value <= field_combo.rx.header_info.requester_id.next;
            end
        end
    end

    //--------------------------------------------------------------------------
    // Write response
    //--------------------------------------------------------------------------
    assign cpuif_wr_ack = decoded_req & decoded_req_is_wr;
    // Writes are always granted with no error response
    assign cpuif_wr_err = '0;

    //--------------------------------------------------------------------------
    // Readback
    //--------------------------------------------------------------------------

    logic [5:0] rd_mux_addr;
    assign rd_mux_addr = decoded_addr;

    logic readback_err;
    logic readback_done;
    logic [31:0] readback_data;
    always_comb begin
        automatic logic [31:0] readback_data_var;
        readback_data_var = '0;
        if(rd_mux_addr == 6'h0) begin
            readback_data_var[31:0] = field_storage.tx.header0.hdr.value;
        end
        if(rd_mux_addr == 6'h4) begin
            readback_data_var[31:0] = field_storage.tx.header1.hdr.value;
        end
        if(rd_mux_addr == 6'h8) begin
            readback_data_var[31:0] = field_storage.tx.header2.hdr.value;
        end
        if(rd_mux_addr == 6'hc) begin
            readback_data_var[31:0] = field_storage.tx.data.payload.value;
        end
        if(rd_mux_addr == 6'h10) begin
            readback_data_var[2:0] = field_storage.rx.status.cpl_status.value;
        end
        if(rd_mux_addr == 6'h14) begin
            readback_data_var[31:0] = field_storage.rx.data.payload.value;
        end
        if(rd_mux_addr == 6'h18) begin
            readback_data_var[6:0] = field_storage.rx.header_info.lower_addr.value;
            readback_data_var[15:8] = field_storage.rx.header_info.tag.value;
            readback_data_var[31:16] = field_storage.rx.header_info.requester_id.value;
        end
        if(rd_mux_addr == 6'h1c) begin
            readback_data_var[15:0] = hwif_in.status.err.cfg_status.next;
            readback_data_var[16] = hwif_in.status.err.msg_err_fatal.next;
        end
        if(rd_mux_addr == 6'h20) begin
            readback_data_var[5:0] = hwif_in.status.phy.tx_buf_av.next;
            readback_data_var[7:6] = hwif_in.status.phy.tx_state.next;
        end
        readback_data = readback_data_var;
        readback_done = decoded_req & ~decoded_req_is_wr;
        readback_err = '0;
    end

    assign cpuif_rd_ack = readback_done;
    assign cpuif_rd_data = readback_data;
    assign cpuif_rd_err = readback_err;
endmodule
